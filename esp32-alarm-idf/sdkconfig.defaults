## esp32-alarm-idf/sdkconfig.defaults
```kconfig
# ESP32-C3 specific configuration
CONFIG_IDF_TARGET="esp32c3"
CONFIG_IDF_TARGET_ESP32C3=y

# Enable WiFi with basic optimizations
CONFIG_ESP32_WIFI_ENABLED=y
CONFIG_ESP32_WIFI_AMPDU_TX_ENABLED=y
CONFIG_ESP32_WIFI_AMPDU_RX_ENABLED=y
CONFIG_ESP32_WIFI_RX_BA_WIN=16
CONFIG_ESP32_WIFI_TX_BA_WIN=16

# WiFi buffer settings
CONFIG_ESP32_WIFI_RX_BUFFER_NUM=16
CONFIG_ESP32_WIFI_TX_BUFFER_NUM=16

# Power management for stability
CONFIG_PM_ENABLE=n

# HTTPS settings
CONFIG_ESP_TLS_INSECURE=y
CONFIG_ESP_TLS_SKIP_SERVER_CERT_VERIFY=y

# HTTP client settings
CONFIG_ESP_HTTP_CLIENT_ENABLE_HTTPS=y

# Increase main task stack size
CONFIG_ESP_MAIN_TASK_STACK_SIZE=8192

# Enable JSON
CONFIG_JSMN_PARENT_LINKS=y

# Crystal frequency for better timing
CONFIG_XTAL_FREQ_40=y

# TCP/IP optimizations for weak signals
CONFIG_LWIP_TCP_SND_BUF_DEFAULT=8192
CONFIG_LWIP_TCP_RCV_WND_DEFAULT=8192
CONFIG_LWIP_TCP_MSS=1436

# Enable WiFi debugging
CONFIG_LOG_DEFAULT_LEVEL_DEBUG=y

# WiFi stability settings
CONFIG_ESP32_WIFI_MGMT_RX_BUFFER_NUM=8
CONFIG_ESP32_WIFI_IRAM_OPT=y
CONFIG_ESP32_WIFI_RX_IRAM_OPT=y
```
